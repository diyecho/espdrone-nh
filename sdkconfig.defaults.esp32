## sdkconfig.defaults.esp32
```kconfig
#
# FreeRTOS
#
CONFIG_FREERTOS_UNICORE=y

# --- Bootloader Fix (Give More Space) ---
CONFIG_BOOTLOADER_OFFSET_IN_FLASH=0x1000
CONFIG_PARTITION_TABLE_OFFSET=0x8000
```
